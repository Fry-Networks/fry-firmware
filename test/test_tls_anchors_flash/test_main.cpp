// The ESP8266 trust anchors are const data in flash, generated by tools/gen_tls_anchors.py. This pins:
//  - the generated name and key bytes equal what is re-derived here, in C++, from each root's full DER (the fixture): the
//    subject Name as a whole DER element, the EC point q, the RSA modulus without its leading zero and the exponent;
//  - the device header builds br_x509_trust_anchor structs and X509List-layout mirrors as const flash data and installs them
//    with no heap X509List; BearSSL's byte reads of flash are covered by the core's handler (build flag).
#include <unity.h>

#include <cstddef>
#include <cstdint>
#include <cstdlib>
#include <cstring>
#include <fstream>
#include <sstream>
#include <string>
#include <vector>

#include "der_fixture.h"
#include "tls_anchor_bytes.h"

namespace {

struct El {
  uint8_t tag;
  size_t hdr;
  size_t len;
  size_t pos;
};

El at(const unsigned char* b, size_t pos) {
  El e;
  e.tag = b[pos];
  e.pos = pos;
  if (b[pos + 1] < 0x80) {
    e.hdr = 2;
    e.len = b[pos + 1];
  } else {
    const size_t n = b[pos + 1] & 0x7F;
    e.len = 0;
    for (size_t i = 0; i < n; i++) e.len = (e.len << 8) | b[pos + 2 + i];
    e.hdr = 2 + n;
  }
  return e;
}

std::vector<El> kids(const unsigned char* b, const El& parent) {
  std::vector<El> out;
  size_t p = parent.pos + parent.hdr;
  const size_t end = p + parent.len;
  while (p < end) {
    El e = at(b, p);
    out.push_back(e);
    p += e.hdr + e.len;
  }
  return out;
}

struct Derived {
  std::vector<unsigned char> dn;
  bool ec = false;
  std::vector<unsigned char> a;  // q, or n
  std::vector<unsigned char> e;  // RSA exponent
};

Derived derive(const unsigned char* der) {
  Derived d;
  const El cert = at(der, 0);
  const El tbs = kids(der, cert)[0];
  std::vector<El> f = kids(der, tbs);
  size_t i = f[0].tag == 0xA0 ? 1 : 0;
  const El subject = f[i + 4];
  const El spki = f[i + 5];
  d.dn.assign(der + subject.pos, der + subject.pos + subject.hdr + subject.len);
  std::vector<El> sp = kids(der, spki);
  const std::vector<El> alg = kids(der, sp[0]);
  const unsigned char* bits = der + sp[1].pos + sp[1].hdr + 1;  // skip the unused-bits byte
  const size_t bitsLen = sp[1].len - 1;
  d.ec = alg[0].len == 7;  // id-ecPublicKey is 7 bytes, rsaEncryption 9
  if (d.ec) {
    d.a.assign(bits, bits + bitsLen);
  } else {
    const El seq = at(bits, 0);
    const std::vector<El> ne = kids(bits, seq);
    const unsigned char* n = bits + ne[0].pos + ne[0].hdr;
    size_t nl = ne[0].len;
    while (nl > 0 && *n == 0) {
      n++;
      nl--;
    }
    d.a.assign(n, n + nl);
    d.e.assign(bits + ne[1].pos + ne[1].hdr, bits + ne[1].pos + ne[1].hdr + ne[1].len);
  }
  return d;
}

template <size_t N>
std::vector<unsigned char> vec(const unsigned char (&a)[N]) {
  return std::vector<unsigned char>(a, a + N);
}

void test_isrg_root_ye_name_and_key_match_the_der() {
  const Derived d = derive(fry_test::kDerYe);
  TEST_ASSERT_TRUE(d.ec);
  TEST_ASSERT_TRUE(d.dn == vec(fry::kAnchorYeDn));
  TEST_ASSERT_TRUE(d.a == vec(fry::kAnchorYeQ));
  TEST_ASSERT_EQUAL_UINT(48, sizeof(fry::kAnchorYeDn));
  TEST_ASSERT_EQUAL_UINT(97, sizeof(fry::kAnchorYeQ));  // P-384 uncompressed point
  TEST_ASSERT_EQUAL_INT(24, fry::kAnchorYeCurve);        // BR_EC_secp384r1
}

void test_sectigo_root_e46_name_and_key_match_the_der() {
  const Derived d = derive(fry_test::kDerE46);
  TEST_ASSERT_TRUE(d.ec);
  TEST_ASSERT_TRUE(d.dn == vec(fry::kAnchorE46Dn));
  TEST_ASSERT_TRUE(d.a == vec(fry::kAnchorE46Q));
  TEST_ASSERT_EQUAL_UINT(97, sizeof(fry::kAnchorE46Dn));
  TEST_ASSERT_EQUAL_INT(24, fry::kAnchorE46Curve);
}

void test_isrg_root_yr_name_and_rsa_key_match_the_der() {
  const Derived d = derive(fry_test::kDerYr);
  TEST_ASSERT_FALSE(d.ec);
  TEST_ASSERT_TRUE(d.dn == vec(fry::kAnchorYrDn));
  TEST_ASSERT_TRUE(d.a == vec(fry::kAnchorYrN));
  TEST_ASSERT_TRUE(d.e == vec(fry::kAnchorYrE));
  TEST_ASSERT_EQUAL_UINT(512, sizeof(fry::kAnchorYrN));  // 4096-bit modulus, leading zero removed
  TEST_ASSERT_EQUAL_UINT(3, sizeof(fry::kAnchorYrE));
  TEST_ASSERT_TRUE(fry::kAnchorYrN[0] >= 0x80);
}

void test_every_name_is_a_whole_der_name_element() {
  // BearSSL's trust-anchor name is the Name SEQUENCE with its tag and length, so the element length equals the array size.
  const std::vector<unsigned char> names[] = {vec(fry::kAnchorYeDn), vec(fry::kAnchorE46Dn), vec(fry::kAnchorYrDn)};
  for (const auto& n : names) {
    TEST_ASSERT_EQUAL_HEX8(0x30, n[0]);
    const El e = at(n.data(), 0);
    TEST_ASSERT_EQUAL_UINT(n.size(), e.hdr + e.len);
  }
}

bool readFile(const std::string& path, std::string& out) {
  std::ifstream f(path.c_str(), std::ios::in | std::ios::binary);
  if (!f) return false;
  std::ostringstream ss;
  ss << f.rdbuf();
  out = ss.str();
  return !out.empty();
}

bool loadSource(const std::string& rel, std::string& out) {
  const std::string self = __FILE__;
  const std::string tail = "test/test_tls_anchors_flash/test_main.cpp";
  if (self.size() >= tail.size() && self.compare(self.size() - tail.size(), tail.size(), tail) == 0 &&
      readFile(self.substr(0, self.size() - tail.size()) + rel, out))
    return true;
  for (const char* u : {"", "../", "../../", "../../../"}) {
    if (readFile(std::string(u) + rel, out)) return true;
  }
  return false;
}

int countOf(const std::string& hay, const std::string& needle) {
  int n = 0;
  for (size_t p = hay.find(needle); p != std::string::npos; p = hay.find(needle, p + needle.size())) n++;
  return n;
}

void test_the_device_header_is_const_flash_data_with_a_pinned_list_layout() {
  std::string h;
  TEST_ASSERT_TRUE(loadSource("src/esp8266/tls_anchors.h", h));
  TEST_ASSERT_EQUAL_INT(3, countOf(h, "static const br_x509_trust_anchor kTa"));
  TEST_ASSERT_EQUAL_INT(3, countOf(h, "static const X509ListMirror kList"));
  TEST_ASSERT_EQUAL_INT(6, countOf(h, "FRY_ANCHOR_ROM = "));
  TEST_ASSERT_EQUAL_INT(3, countOf(h, "BR_X509_TA_CA"));
  TEST_ASSERT_TRUE(h.find("static_assert(sizeof(BearSSL::X509List) == sizeof(X509ListMirror)") != std::string::npos);
  TEST_ASSERT_TRUE(h.find("offsetof(X509ListMirror, ta) == sizeof(size_t) + sizeof(void*)") != std::string::npos);
  TEST_ASSERT_TRUE_MESSAGE(h.find("new ") == std::string::npos && h.find("malloc") == std::string::npos, "no heap in the anchors");
  std::string b;
  TEST_ASSERT_TRUE(loadSource("lib/fry_core/tls_anchor_bytes.h", b));
  TEST_ASSERT_TRUE(b.find("#define FRY_ANCHOR_ROM PROGMEM") != std::string::npos);
  TEST_ASSERT_EQUAL_INT(7, countOf(b, "FRY_ANCHOR_ROM = {"));
}

void test_the_device_installs_a_flash_list_with_no_heap_x509list_and_checks_it_at_run_time() {
  std::string c;
  TEST_ASSERT_TRUE(loadSource("src/esp8266/http_tls.cpp", c));
  const size_t ens = c.find("bool ensureTrustAnchors(fry::TrustSet want) {");
  TEST_ASSERT_TRUE(ens != std::string::npos);
  const std::string body = c.substr(ens, c.find("\n}\n", ens) - ens);
  TEST_ASSERT_TRUE(body.find("fry::anchorListFor(want)") != std::string::npos);
  TEST_ASSERT_TRUE(body.find("opaqueList(l)") != std::string::npos);
  TEST_ASSERT_TRUE(body.find("anchor list layout unexpected - refusing") != std::string::npos);
  TEST_ASSERT_TRUE_MESSAGE(body.find("return false;") < body.find("gTrust.list = l;"), "fail closed before the list is installed");
  TEST_ASSERT_TRUE_MESSAGE(body.find("new ") == std::string::npos && body.find("delete ") == std::string::npos, "no heap list");
  TEST_ASSERT_TRUE(c.find("BearSSL::X509List* l = new") == std::string::npos);
  TEST_ASSERT_TRUE(c.find("stripDerCopies") == std::string::npos);
  TEST_ASSERT_TRUE(c.find("tls_der_strip.h") == std::string::npos);
}

void test_the_generator_check_passes_on_the_committed_files() {
  // tools/gen_tls_anchors.py --check re-derives every anchor from data/cert/*.pem and checks it against the three generated files.
  std::string probe;
  std::string prefix;
  bool found = false;
  const std::string self = __FILE__;
  const std::string tail = "test/test_tls_anchors_flash/test_main.cpp";
  std::vector<std::string> prefixes;
  if (self.size() >= tail.size()) prefixes.push_back(self.substr(0, self.size() - tail.size()));
  for (const char* u : {"", "../", "../../", "../../../"}) prefixes.push_back(u);
  for (const std::string& p : prefixes) {
    if (readFile(p + "tools/gen_tls_anchors.py", probe)) {
      prefix = p;
      found = true;
      break;
    }
  }
  TEST_ASSERT_TRUE_MESSAGE(found, "cannot find tools/gen_tls_anchors.py");
  const std::string cmd = "python3 -I '" + prefix + "tools/gen_tls_anchors.py' --check";
  TEST_ASSERT_EQUAL_INT_MESSAGE(0, std::system(cmd.c_str()), "generated anchors differ from data/cert (run tools/gen_tls_anchors.py)");
}

void test_the_byte_load_handler_is_on_for_the_esp8266_envs_only() {
  std::string ini;
  TEST_ASSERT_TRUE(loadSource("platformio.ini", ini));
  TEST_ASSERT_EQUAL_INT(1, countOf(ini, "-DNON32XFER_HANDLER"));
  const size_t at8266 = ini.find("[env:esp8266]");
  const size_t flag = ini.find("-DNON32XFER_HANDLER");
  const size_t nextEnv = ini.find("\n[env:", at8266 + 1);
  TEST_ASSERT_TRUE(at8266 != std::string::npos && at8266 < flag && flag < nextEnv);
}

}  // namespace

void setUp() {}
void tearDown() {}

int main(int, char**) {
  UNITY_BEGIN();
  RUN_TEST(test_isrg_root_ye_name_and_key_match_the_der);
  RUN_TEST(test_sectigo_root_e46_name_and_key_match_the_der);
  RUN_TEST(test_isrg_root_yr_name_and_rsa_key_match_the_der);
  RUN_TEST(test_every_name_is_a_whole_der_name_element);
  RUN_TEST(test_the_device_header_is_const_flash_data_with_a_pinned_list_layout);
  RUN_TEST(test_the_device_installs_a_flash_list_with_no_heap_x509list_and_checks_it_at_run_time);
  RUN_TEST(test_the_generator_check_passes_on_the_committed_files);
  RUN_TEST(test_the_byte_load_handler_is_on_for_the_esp8266_envs_only);
  return UNITY_END();
}
